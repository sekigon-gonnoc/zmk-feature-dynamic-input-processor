## Kconfig
```kconfig
# SPDX-License-Identifier: MIT

config ZMK_DYNAMIC_INPUT_PROCESSOR
	bool "Runtime pointer input processor"
	depends on ZMK_DYNAMIC_SETTINGS && ZMK_POINTING
	default n
	help
	  Enable the all-in-one pointer processor for cursor,
	  scroll, encoder, axis snapping, and automatic mouse layer behavior.

config ZMK_DYNAMIC_INPUT_PROCESSOR_POINTER_ENCODER_COUNT
	int "Number of pointer encoder targets"
	depends on ZMK_DYNAMIC_INPUT_PROCESSOR
	range 0 8
	default 0
	help
	  Number of independently addressable encoder targets exposed by the
	  pointer processor. Each target maps X and Y to two sensor indices.
```

## dts/bindings/behaviors/zmk,behavior-pointer-encoder.yaml
```yaml
# SPDX-License-Identifier: MIT

description: Temporarily force a pointer input processor into encoder mode

compatible: "zmk,behavior-pointer-encoder"

include: one_param.yaml

properties:
  processor:
    type: phandle
    required: true
```

## dts/bindings/behaviors/zmk,behavior-pointer-scroll.yaml
```yaml
# SPDX-License-Identifier: MIT

description: Temporarily force a pointer input processor into scroll mode

compatible: "zmk,behavior-pointer-scroll"

include: zero_param.yaml

properties:
  processor:
    type: phandle
    required: true
```

## dts/bindings/input_processors/zmk,input-processor-pointer.yaml
```yaml
# SPDX-License-Identifier: MIT

description: All-in-one runtime pointer input processor

compatible: "zmk,input-processor-pointer"

include: ip_common.yaml

properties:
  "#input-processor-cells":
    type: int
    required: true
    const: 0
  type:
    type: int
    default: 2
    description: Relative input event type (INPUT_EV_REL).
  x-code:
    type: int
    default: 0
    description: Relative X code (INPUT_REL_X).
  y-code:
    type: int
    default: 1
    description: Relative Y code (INPUT_REL_Y).
  encoder-sensor-indices:
    type: array
    description: X/Y keymap sensor indices for each configured encoder target
    default: []
  rotation-deg:
    type: int
    default: 0
  fine-layers:
    type: int
    default: 0
  fine-coef:
    type: int
    default: 1
  rough-layers:
    type: int
    default: 0
  rough-coef:
    type: int
    default: 1
  shift-point-0:
    type: int
    default: 1
  shift-point-1:
    type: int
    default: 128
  shift-point-2:
    type: int
    default: 255
  shift-rate-0:
    type: int
    default: 100
  shift-rate-1:
    type: int
    default: 100
  shift-rate-2:
    type: int
    default: 100
  scroll-layers:
    type: int
    default: 0
  scroll-invert:
    type: boolean
  scroll-snap:
    type: boolean
  scroll-divisor:
    type: int
    default: 1
  encoder-layers:
    type: int
    default: 0
  encoder-snap-layers:
    type: int
    default: 0
  encoder-divisor:
    type: int
    default: 50
  aml-enabled:
    type: boolean
  aml-layer:
    type: int
    default: 1
  aml-timeout-ms:
    type: int
    default: 400
  aml-debounce-ms:
    type: int
    default: 25
  aml-threshold:
    type: int
    default: 10
  aml-delay-ms:
    type: int
    default: 200

input-processor-cells: []
```
